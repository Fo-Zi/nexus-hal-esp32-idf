## west.yml
```yaml
manifest:
  remotes:
    - name: fozi
      url-base: https://github.com/Fo-Zi
  projects:
    - name: nexus-hal-interface
      remote: fozi
      revision: main
      path: hal-interface
```
